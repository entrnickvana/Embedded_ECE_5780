# file: lab2.ioc
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Mcu.Family=STM32F0
Mcu.Name=STM32F072R(8-B)Tx
Mcu.Package=LQFP64
ProjectManager.HeapSize=0x200
ProjectManager.StackSize=0x400
ProjectManager.TargetToolchain=MDK-ARM V5
board=lab2

// file: Src/main.c
/**
  ******************************************************************************
  * @file           : main.c
  * @brief          : Main program body
  ******************************************************************************
  ** This notice applies to any and all portions of this file
  * that are not between comment pairs USER CODE BEGIN and
  * USER CODE END. Other portions of this file, whether
  * inserted by the user or by software development tools
  * are owned by their respective copyright owners.
  *
  * COPYRIGHT(c) 2018 STMicroelectronics
  *
  * Redistribution and use in source and binary forms, with or without modification,
  * are permitted provided that the following conditions are met:
  *   1. Redistributions of source code must retain the above copyright notice,
  *      this list of conditions and the following disclaimer.
  *   2. Redistributions in binary form must reproduce the above copyright notice,
  *      this list of conditions and the following disclaimer in the documentation
  *      and/or other materials provided with the distribution.
  *   3. Neither the name of STMicroelectronics nor the names of its contributors
  *      may be used to endorse or promote products derived from this software
  *      without specific prior written permission.
  *
  * THIS SOFTWARE IS PROVIDED BY THE COPYRIGHT HOLDERS AND CONTRIBUTORS "AS IS"
  * AND ANY EXPRESS OR IMPLIED WARRANTIES, INCLUDING, BUT NOT LIMITED TO, THE
  * IMPLIED WARRANTIES OF MERCHANTABILITY AND FITNESS FOR A PARTICULAR PURPOSE ARE
  * DISCLAIMED. IN NO EVENT SHALL THE COPYRIGHT HOLDER OR CONTRIBUTORS BE LIABLE
  * FOR ANY DIRECT, INDIRECT, INCIDENTAL, SPECIAL, EXEMPLARY, OR CONSEQUENTIAL
  * DAMAGES (INCLUDING, BUT NOT LIMITED TO, PROCUREMENT OF SUBSTITUTE GOODS OR
  * SERVICES; LOSS OF USE, DATA, OR PROFITS; OR BUSINESS INTERRUPTION) HOWEVER
  * CAUSED AND ON ANY THEORY OF LIABILITY, WHETHER IN CONTRACT, STRICT LIABILITY,
  * OR TORT (INCLUDING NEGLIGENCE OR OTHERWISE) ARISING IN ANY WAY OUT OF THE USE
  * OF THIS SOFTWARE, EVEN IF ADVISED OF THE POSSIBILITY OF SUCH DAMAGE.
  *
  ******************************************************************************
  */
#include "main.h"
#include "stm32f0xx_hal.h"

/* USER CODE BEGIN PV */
/* Private variables ---------------------------------------------------------*/

/* USER CODE END PV */

void SystemClock_Config(void);
void EXTI0_1_IRQHandler(void);
/* USER CODE BEGIN PFP */
/* Private function prototypes -----------------------------------------------*/

/* USER CODE END PFP */

/* USER CODE BEGIN 0 */
uint32_t my_sys_tick_count = 0;

/* USER CODE END 0 */

int main(void)
{
  //HAL_Init(); // Reset of all peripherals, init the Flash and Systick
SystemClock_Config(); //Configure the system clock
/* This example uses HAL library calls to control
the GPIOC peripheral. You'll be redoing this code
with hardware register access. */

  // ***DISABLED***
//  __HAL_RCC_GPIOC_CLK_ENABLE(); // Enable the GPIOC clock in the RCC

// Set up a configuration struct to pass to the initialization function

// --- USEFUL INFO ---
/*
    __IO uint32_t AHBENR;     !< RCC AHB peripheral clock register,                           Address offset: 0x14
*/

GPIO_InitTypeDef initStr = {GPIO_PIN_8 | GPIO_PIN_9,
GPIO_MODE_OUTPUT_PP,
GPIO_SPEED_FREQ_LOW,
GPIO_NOPULL};

// $$$$$ GPIOC->MODER = 0x50000;

// $$$$$ GPIOC->MODER |= 0b00001000; // Sets the 3rd bit

// $$$$$ GPIOC->MODER &= ~(0b00001000); // Clears the 3rd bit

// $$$$$ GPIOC->MODER ^= 0b00001000; // Inverts the 3rd bit

// $$$$$ RCC->APB1ENR |= RCC_APB1ENR_TIM2EN; // Enable peripheral clock to TIMER2

// Sets the 3rd bit in the GPIOC_MODER register
// $$$$$  GPIOC->MODER |= (1 << 3);

// Sets the 3rd and 5th bits in the GPIOC_MODER register
// $$$$$  GPIOC->MODER |= (1 << 3) | (1 << 5);

// Clears the 3rd and 5th bits in the GPIOC_MODER register
// $$$$$  GPIOC->MODER &= ~((1 << 3) | (1 << 5));

//HAL_GPIO_Init(GPIOC, &initStr); // Initialize pins PC8 & PC9

//------------------------------------------------------------------------
// NEW CODE --------------------------------------------------------------

int pressed = 0;

// 1- Enable GPIO C clock
  RCC->AHBENR |= RCC_AHBENR_GPIOCEN | RCC_AHBENR_GPIOAEN;

// +++++++++++++++ SET LEDS +++++++++++++++++++++
// 2- Set GPIOC MODE to GENERAL OUTPUT ( 01 )

  //clear MSB PC9
    GPIOC->MODER &= ~((1 << 19));
  //SET LSB PC9
    GPIOC->MODER |= (1 << 18);

  //clear MSB PC8
    GPIOC->MODER &= ~((1 << 17));
  //SET LSB PC8
    GPIOC->MODER |= (1 << 16);

  //clear MSB PC7
    GPIOC->MODER &= ~((1 << 15));
  //SET LSB PC7
    GPIOC->MODER |= (1 << 14);

  //clear MSB PC6
    GPIOC->MODER &= ~((1 << 13));
  //SET LSB PC6
    GPIOC->MODER |= (1 << 12);

    // 3- Set GPIOC OTYPER to OUTPUT PUSH-PULL

  //SET bit 9, 8 to 0 for PC8, PC9, PC6
    GPIOC->OTYPER &= ~(( 1<<8) | (1<<9)) | ((1<<7)) | ((1<<6));

// 4- Set GPIOC OSPEEDR to x0

  //SET bit 18, 16 to 0
    GPIOC->OSPEEDR &= ~(( 1<<18) | (1<<16) | ((1<<14)) | (1 << 12));

// 5- Set GPIOC PUDR to 0 for bits 19-16

  // SET bit 19, 18, 17, 16 to 0
    GPIOC->PUPDR &=   ~((1<<19)     //MSB PC9
                      | (1<<18)     //LSB PC9
                      | (1<<17)     //MSB PC8
                      | (1<<16)     //LSB PC8
                      | (1<<15)     //LSB PC7
                      | (1<<14)     //MSB PC7
                      | (1<<13)     //MSB PC6
                      | (1<<12));   //LSB PC6

//++++++++++++++++ SET USER BUTTON ++++++++++++++++++++

  //SET BUTTON MODE to 00
    GPIOA->MODER &= ((1<<0) | (1<<1));

  //SET BUTTON SPEED to 00
    GPIOA->OSPEEDR &= ~(( 1<<0) | (1<<1));

  //SET BUTTON PUPDR to 10 (PULL-DOWN)
    GPIOA->PUPDR &= ~( 1<<0); //SET bit 0
    GPIOA->PUPDR |=  ( 1<<1); //CLEAR bit 1

//------------------  INTERRUPT EXT   ----------------------

/* (2) Select Port A for pin 0 external interrupt by writing 0000 in EXTI0 (reset value)*/

/* (3) Configure the corresponding mask bit in the EXTI_IMR register */

/* (4) Configure the Trigger Selection bits of the Interrupt line on rising edge*/

/* (5) Configure the Trigger Selection bits of the Interrupt line on falling edge*/

RCC->APB2ENR |= 0x0001;
SYSCFG->EXTICR[1] |= (uint16_t)SYSCFG_EXTICR1_EXTI0_PA; /* (2) */

EXTI->IMR = 0x0001; /* (3)  Mask the MRO */
EXTI->RTSR = 0x0001; /* (4) Rising Edge Enabled */
EXTI->FTSR = 0x0000; /* (5) Falling Edge Disabled */

/* Configure NVIC for External Interrupt */

  /* (1) Enable Interrupt on EXTI0_1 */
  NVIC_EnableIRQ(EXTI0_1_IRQn);

  /* (2) Set priority for EXTI0_1 */
  //NVIC_SetPriority(EXTI0_1_IRQn,1);

  // Checkoff 2 Part B
  NVIC_SetPriority(EXTI0_1_IRQn,1);

  // Checkoff 2 Part A
  /* Set Systick Interrupt Priority  */
  NVIC_SetPriority(SysTick_IRQn,2);

/*
  PC7 = BLUE
  PC8 = Orange
  PC9 = Green
  PA0 = User Button
*/

 //HAL_GPIO_WritePin(GPIOC, GPIO_PIN_8, GPIO_PIN_SET); // Start PC8 high

  // INITIALIZE PC9 as HI
  GPIOC->ODR |= ((1<<9));

  // INITIALIZE PC8 as HI

  GPIOC->ODR |= ((1<<6));

  while (1) {

  	GPIOC->ODR ^= (1<<6);  //INVERT PC9
  	HAL_Delay(400);

  }

}

void SystemClock_Config(void)
{

  RCC_OscInitTypeDef RCC_OscInitStruct;
  RCC_ClkInitTypeDef RCC_ClkInitStruct;

    /**Initializes the CPU, AHB and APB busses clocks
    */
  RCC_OscInitStruct.OscillatorType = RCC_OSCILLATORTYPE_HSI;
  RCC_OscInitStruct.HSIState = RCC_HSI_ON;
  RCC_OscInitStruct.HSICalibrationValue = 16;
  RCC_OscInitStruct.PLL.PLLState = RCC_PLL_NONE;
  if (HAL_RCC_OscConfig(&RCC_OscInitStruct) != HAL_OK)
  {
    _Error_Handler(__FILE__, __LINE__);
  }

    /**Initializes the CPU, AHB and APB busses clocks
    */
  RCC_ClkInitStruct.ClockType = RCC_CLOCKTYPE_HCLK|RCC_CLOCKTYPE_SYSCLK
                              |RCC_CLOCKTYPE_PCLK1;
  RCC_ClkInitStruct.SYSCLKSource = RCC_SYSCLKSOURCE_HSI;
  RCC_ClkInitStruct.AHBCLKDivider = RCC_SYSCLK_DIV1;
  RCC_ClkInitStruct.APB1CLKDivider = RCC_HCLK_DIV1;

  if (HAL_RCC_ClockConfig(&RCC_ClkInitStruct, FLASH_LATENCY_0) != HAL_OK)
  {
    _Error_Handler(__FILE__, __LINE__);
  }

    /**Configure the Systick interrupt time
    */
//  HAL_SYSTICK_Config(HAL_RCC_GetHCLKFreq()/1000);
  HAL_SYSTICK_Config(HAL_RCC_GetHCLKFreq()/1000);
    /**Configure the Systick

    */
  // new comment
  HAL_SYSTICK_CLKSourceConfig(SYSTICK_CLKSOURCE_HCLK);

  /* SysTick_IRQn interrupt configuration */
  HAL_NVIC_SetPriority(SysTick_IRQn, 0, 0);
}

void _Error_Handler(char *file, int line)
{
  while(1)
  {
  }
}

void EXTI0_1_IRQHandler(void)
{
    // TOGGLE bits 8,9
    GPIOC->ODR ^=   ((1<<9)   //INVERT PC9
                  | (1<<8));  //INVERT PC8

    HAL_Delay(1500000);

        // TOGGLE bits 8,9
    GPIOC->ODR ^=   ((1<<9)   //INVERT PC9
                  | (1<<8));  //INVERT PC8

    EXTI->PR |= 0x0001;
}

/************************ (C) COPYRIGHT STMicroelectronics *****END OF FILE****/
